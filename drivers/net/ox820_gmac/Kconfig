## drivers/net/ox820_gmac/Kconfig
```kconfig
menuconfig OX820_GMAC
	tristate "OX820: Synopsys Gigabit MAC"
	select CRC32
	select MII
	depends on ARCH_OX820 || ARCH_OXNAS
	help
		Driver for the Synopsys Gigabit MAC

if OX820_GMAC

endif
```
